## meta-robotics/conf/layer.conf
```bitbake
# =================================================================
# META-ROBOTICS LAYER CONFIGURATION
# =================================================================
# This configuration file tells the Yocto build system about our layer
# It defines where to find recipes, dependencies, and compatibility
# =================================================================

# =================================================================
# LAYER PATH CONFIGURATION
# =================================================================
# Add this layer's directory to BitBake's search path
# BBPATH is the environment variable storing paths for BitBake to search
# LAYERDIR is the absolute path to the directory containing this file
# The .= operator appends to the existing value with a separator
# =================================================================
BBPATH .= ":${LAYERDIR}"

# =================================================================
# RECIPE LOCATIONS
# =================================================================
# Tell BitBake where to find our recipes and bbappend files
# This uses a pattern to match:
# - Any .bb files in recipes-*/*/ directories
# - Any .bbappend files in recipes-*/*/ directories
# =================================================================
BBFILES += "${LAYERDIR}/recipes-*/*/*.bb \
            ${LAYERDIR}/recipes-*/*/*.bbappend"

# =================================================================
# LAYER IDENTIFICATION
# =================================================================
# Register this layer with a unique name in the BitBake system
BBFILE_COLLECTIONS += "meta-robotics"

# Define which files belong to this layer (all files under this directory)
BBFILE_PATTERN_meta-robotics = "^${LAYERDIR}/"

# Set this layer's priority (higher number = higher priority when recipes conflict)
# Priority 10 is a common middle value
BBFILE_PRIORITY_meta-robotics = "10"

# =================================================================
# DEPENDENCIES & COMPATIBILITY
# =================================================================
# Define which layers this layer depends on
# At minimum we need the "core" layer for basic functionality
LAYERDEPENDS_meta-robotics = "core"

# Define which Yocto releases this layer is compatible with
# This must be updated when testing with new Yocto releases
# - langdale: Yocto 4.0 (2022.10)
# - mickledore: Yocto 4.1 (2023.04) 
# - nanbield: Yocto 4.2 (2023.10)
# - scarthgap: Yocto 4.3 (2024.04)
# =================================================================
LAYERSERIES_COMPAT_meta-robotics = "langdale mickledore nanbield scarthgap"
```

## meta-robotics/conf/machine/beaglebone-robotics.conf
```bitbake
# Inherit base BeagleBone configuration
require conf/machine/beaglebone-yocto.conf

# Enable robotics and hardware features
MACHINE_FEATURES += "robotics gpio i2c spi uart usbhost wifi bluetooth"
MACHINE_FEATURES_BACKFILL_CONSIDERED += "rtc"

# Enable systemd and wireless features
DISTRO_FEATURES:append = " wifi bluetooth systemd pam"
VIRTUAL-RUNTIME_init_manager = "systemd"
DISTRO_FEATURES_BACKFILL_CONSIDERED = "sysvinit"
VIRTUAL-RUNTIME_initscripts = ""

# Ensure robotics controller is always installed
MACHINE_ESSENTIAL_EXTRA_RDEPENDS += "robotics-controller"

# Use real-time kernel and set device tree
PREFERRED_PROVIDER_virtual/kernel = "linux-yocto-rt"
PREFERRED_VERSION_linux-yocto-rt = "5.15%"
KERNEL_DEVICETREE = "am335x-boneblack.dtb"

# U-Boot and overrides for BeagleBone
UBOOT_MACHINE = "am335x_evm_config"
MACHINEOVERRIDES =. "beaglebone:"
KERNEL_CONFIG_NAME = "beaglebone"
```

## meta-robotics/conf/machine/qemu-robotics.conf
```bitbake
# Inherit base QEMU ARM64 configuration
require conf/machine/qemuarm64.conf

# Enable robotics features
MACHINE_FEATURES += "robotics"
MACHINE_FEATURES_BACKFILL_CONSIDERED += "rtc"

# Enable systemd and security features
DISTRO_FEATURES:append = " systemd pam"
VIRTUAL-RUNTIME_init_manager = "systemd"
DISTRO_FEATURES_BACKFILL_CONSIDERED = "sysvinit"
VIRTUAL-RUNTIME_initscripts = ""

# Always install robotics controller for testing
MACHINE_ESSENTIAL_EXTRA_RDEPENDS += "robotics-controller"

# QEMU emulation settings
QB_MEM = "1024M"
QB_MACHINE = "-machine virt"
QB_CPU = "-cpu cortex-a57"
QB_KERNEL_CMDLINE_APPEND = "console=ttyAMA0,115200"
QB_ACCEL = "-accel kvm:tcg"

# Use QEMU kernel overrides
MACHINEOVERRIDES =. "qemuarm64:"

# Use real-time kernel for robotics
PREFERRED_PROVIDER_virtual/kernel = "linux-yocto-rt"
PREFERRED_VERSION_linux-yocto-rt = "5.15%"
KERNEL_CONFIG_NAME = "qemuarm64"
KBRANCH = "v5.15/standard/preempt-rt/base"
KMACHINE = "qemuarm64"
```

## meta-robotics/conf/machine/raspberrypi3.conf
```bitbake
#@TYPE: Machine
#@NAME: Raspberry Pi 3 Robotics Platform
#@DESCRIPTION: Machine configuration for RPi3-based robotics controller

require conf/machine/raspberrypi3-64.conf

MACHINE_FEATURES += "robotics gpio i2c spi uart bluetooth wifi vc4graphics"
MACHINE_FEATURES_BACKFILL_CONSIDERED += "rtc"

# Enable systemd, wireless, and security features
DISTRO_FEATURES:append = " wifi bluetooth systemd pam opengl"
VIRTUAL-RUNTIME_init_manager = "systemd"
DISTRO_FEATURES_BACKFILL_CONSIDERED = "sysvinit"
VIRTUAL-RUNTIME_initscripts = ""

# Additional packages for robotics
MACHINE_ESSENTIAL_EXTRA_RDEPENDS += "robotics-controller"

# GPU and interface settings for robotics applications
GPU_MEM = "64"
ENABLE_UART = "1"
ENABLE_I2C = "1"
ENABLE_SPI = "1"
VIDEO_CAMERA = "1"

# Use RT kernel for real-time robotics performance
PREFERRED_PROVIDER_virtual/kernel = "linux-raspberrypi"
KERNEL_FEATURES:append = " features/rt/rt.scc"

# Allow kernel and other recipes for raspberrypi3 to be used
MACHINEOVERRIDES =. "raspberrypi3:"
KERNEL_CONFIG_NAME = "raspberrypi3"
```

## meta-robotics/conf/machine/rpi4-robotics.conf
```bitbake
# Inherit base Raspberry Pi 4 configuration
require conf/machine/raspberrypi4-64.conf

# Enable robotics and hardware features
MACHINE_FEATURES += "robotics gpio i2c spi uart bluetooth wifi vc4graphics usbhost"
MACHINE_FEATURES_BACKFILL_CONSIDERED += "rtc"

# Enable systemd, wireless, and OpenGL
DISTRO_FEATURES:append = " wifi bluetooth systemd pam opengl"
VIRTUAL-RUNTIME_init_manager = "systemd"
DISTRO_FEATURES_BACKFILL_CONSIDERED = "sysvinit"
VIRTUAL-RUNTIME_initscripts = ""

# Always install robotics controller
MACHINE_ESSENTIAL_EXTRA_RDEPENDS += "robotics-controller"

# GPU and interface settings for robotics
GPU_MEM = "128"
ENABLE_UART = "1"
ENABLE_I2C = "1"
ENABLE_SPI = "1"
VIDEO_CAMERA = "1"

# Use real-time kernel for robotics
PREFERRED_PROVIDER_virtual/kernel = "linux-yocto-rt"

# Use RPi4 kernel overrides
MACHINEOVERRIDES =. "raspberrypi4:"
KERNEL_CONFIG_NAME = "raspberrypi4"
```
